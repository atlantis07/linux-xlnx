## Documentation/devicetree/bindings/arm/xilinx.txt
```
Xilinx Zynq Platforms Device Tree Bindings

Boards with Zynq-7000 SOC based on an ARM Cortex A9 processor
shall have the following properties.

Required root node properties:
    - compatible = "xlnx,zynq-7000";

Additional compatible strings:

- Xilinx internal board cc108
  "xlnx,zynq-cc108"

- Xilinx internal board zc770 with different FMC cards
  "xlnx,zynq-zc770-xm010"
  "xlnx,zynq-zc770-xm011"
  "xlnx,zynq-zc770-xm012"

---------------------------------------------------------------

Xilinx Zynq UltraScale+ MPSoC Platforms Device Tree Bindings

Boards with ZynqMP SOC based on an ARM Cortex A53 processor
shall have the following properties.

Required root node properties:
    - compatible = "xlnx,zynqmp";
```
